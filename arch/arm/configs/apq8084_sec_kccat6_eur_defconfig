## arch/arm/configs/apq8084_sec_kccat6_eur_defconfig
```kconfig
CONFIG_SEC_KCCAT6_PROJECT=y
#
# MAX77828 IC
#
CONFIG_EXTCON=y
CONFIG_EXTCON_MAX77828=y
CONFIG_MFD_MAX77828=y
CONFIG_MOTOR_DRV_MAX77828=y
CONFIG_SS_VIBRATOR=y
CONFIG_LEDS_MAX77828=y
#
# MAX77804K IC
#
CONFIG_MFD_MAX77804K=y
CONFIG_EXTCON_MAX77804K=y
CONFIG_MUIC_SUPPORT_WATERRESISTANCE=y
CONFIG_MOTOR_DRV_MAX77804K=y
#
# IDCHIP
#
#CONFIG_INPUT_HALLIC=y
CONFIG_SENSORS_HALL=y
CONFIG_W1=y
CONFIG_W1_MASTER_GPIO_MSM=y
CONFIG_W1_SLAVE_DS28E15=y
CONFIG_W1_WORKQUEUE=y
CONFIG_W1_FAST_CHECK=y
CONFIG_W1_SN=y
#
# Battery & Charger
#
# CONFIG_SMB350_CHARGER is not set
# CONFIG_BATTERY_BQ28400 is not set
# CONFIG_BATTERY_MSM is not set
# CONFIG_FUELGAUGE_DUMMY is not set
#
# MAX77823 Charger
#
# CONFIG_QPNP_CHARGER is not set
# CONFIG_QPNP_BMS is not set
CONFIG_CHARGER_MAX77804K=y
CONFIG_FUELGAUGE_MAX17048=y
CONFIG_SAMSUNG_LPM_MODE=y
CONFIG_BATTERY_SAMSUNG=y
CONFIG_BATTERY_SAMSUNG_DATA_FILE="kccat6_battery_data.h"
CONFIG_BATTERY_SWELLING=y

# Earjack
CONFIG_CODEC_EAR_BIAS=y

#
# NFC
#
CONFIG_NFC_PN547=y
CONFIG_NFC_PN547_8084_USE_BBCLK2=y

#
#TSP, TKEY, Booster
#
CONFIG_TOUCHSCREEN_SYNAPTICS_I2C_RMI_G=y
CONFIG_KEYBOARD_CYPRESS_TOUCHKEY=y
# CONFIG_INPUT_BOOSTER is not set

#
# LCD PANEL INFO
#
CONFIG_PANEL_S6E3FA2_AMS510CV01_FHD=y

#
# Finger print sensor
#
CONFIG_SENSORS_FINGERPRINT=y
CONFIG_SENSORS_FINGERPRINT_SYSFS=y
CONFIG_SENSORS_VFS61XX=y
CONFIG_SENSORS_VFS61XX_KO=y

# SensorHub
CONFIG_SENSORS_SSP=y
CONFIG_SENSORS_SYSFS=y
CONFIG_SENSORS_SSP_ATMEL=y
CONFIG_SENSORS_SSP_SENSORHUB=y
CONFIG_SENSORS_SSP_FACTORY=y
CONFIG_SENSORS_SSP_MPU6500=y
CONFIG_SENSORS_SSP_LPS25H=y
CONFIG_SENSORS_SSP_YAS532=y
CONFIG_SENSORS_SSP_TMG399X=y
CONFIG_SENSORS_SSP_MOBEAM=y
CONFIG_SENSORS_SSP_ATUC128L5HAR=y
CONFIG_IIO=y
CONFIG_IIO_BUFFER=y
CONFIG_IIO_KFIFO_BUF=y
CONFIG_IIO_TRIGGER=y

# Hrm Sensor
CONFIG_SENSORS_MAX86900=y

#
# CAMERA
#
CONFIG_S5K2P2XX=y
CONFIG_COMPANION=y
CONFIG_LEDS_MAX77828=y
CONFIG_LEDS_MAX77804K=y
CONFIG_DEBUG_FLASH is not set

CONFIG_LEDS_MAX77828_RGB=y
#CONFIG IR LED
CONFIG_SEC_FPGA_ICE40XX=y

#HDMI
CONFIG_SEC_MHL_SII8240=y
CONFIG_MHL_VERSION=0x21

CONFIG_LEDS_AN30259A=y

#QCOM BT
CONFIG_MSM_BT_POWER=y
# CONFIG_BT_BCM4358 is not set

# CONFIG_KNOX_KAP is not set

# Samsung ODE
CONFIG_FORCE_DISABLE_FIPS=y

#SEC Features
# CONFIG_SEC_SSR_DEBUG_LEVEL_CHK is not set

# QCOM QCA6174 Wifi
CONFIG_CNSS=y
CONFIG_WCNSS_MEM_PRE_ALLOC=y
CONFIG_CLD_LL_CORE=y
CONFIG_CNSS_MAC_BUG=y
CONFIG_QCA_CLD_WLAN=y
CONFIG_QCACLD_WLAN_LFR3=y
CONFIG_QCOM_VOWIFI_11R=y
CONFIG_QCOM_LTE_COEX=y
CONFIG_QCOM_TDLS=y
CONFIG_PRIMA_WLAN_OKC=y
CONFIG_PRIMA_WLAN_11AC_HIGH_TP=y
CONFIG_WLAN_FEATURE_11W=y
CONFIG_WLAN_FEATURE_LPSS=y
CONFIG_WLAN_FEATURE_NAN=y
```

## arch/arm/configs/apq8084_sec_lentislte_skt_defconfig
```kconfig
CONFIG_SEC_LENTIS_PROJECT=y
CONFIG_MACH_LENTISLTE_SKT=y
#
# MAX77828 IC
#
CONFIG_EXTCON=y
CONFIG_EXTCON_MAX77828=y
CONFIG_MFD_MAX77828=y
CONFIG_MOTOR_DRV_MAX77828=y
CONFIG_SS_VIBRATOR=y
CONFIG_LEDS_MAX77828=y
CONFIG_MUIC_SUPPORT_WATERRESISTANCE=y
#
# MAX77804K IC
#
CONFIG_MFD_MAX77804K=y
CONFIG_EXTCON_MAX77804K=y
CONFIG_MOTOR_DRV_MAX77804K=y
#
# IDCHIP
#
#CONFIG_INPUT_HALLIC=y
CONFIG_SENSORS_HALL=y
CONFIG_W1=y
CONFIG_W1_MASTER_GPIO_MSM=y
CONFIG_W1_SLAVE_DS28E15=y
CONFIG_W1_WORKQUEUE=y
CONFIG_W1_FAST_CHECK=y
CONFIG_W1_SN=y
#
# Battery & Charger
#
# CONFIG_SMB350_CHARGER is not set
# CONFIG_BATTERY_BQ28400 is not set
# CONFIG_BATTERY_MSM is not set
# CONFIG_FUELGAUGE_DUMMY is not set
#
# MAX77823 Charger
#
# CONFIG_QPNP_CHARGER is not set
# CONFIG_QPNP_BMS is not set
CONFIG_MFD_MAX77823=y
CONFIG_FUELGAUGE_MAX77823=y
CONFIG_FUELGAUGE_MAX77823_COULOMB_COUNTING=y
CONFIG_CHARGER_MAX77823=y
CONFIG_CHARGER_MAX77804K=y
CONFIG_FUELGAUGE_MAX17048=y
CONFIG_SAMSUNG_LPM_MODE=y
CONFIG_BATTERY_SAMSUNG=y
CONFIG_BATTERY_SAMSUNG_DATA_FILE="lentis_battery_data.h"
CONFIG_SAMSUNG_BATTERY_DISALLOW_DEEP_SLEEP=y
CONFIG_BATTERY_SWELLING=y

# Earjack
CONFIG_CODEC_EAR_BIAS=y

#
# NFC
#
CONFIG_NFC_PN547=y
CONFIG_NFC_PN547_8084_USE_BBCLK2=y

#
#TSP, TKEY, Booster
#
CONFIG_TOUCHSCREEN_SYNAPTICS_I2C_RMI_G=y
CONFIG_KEYBOARD_CYPRESS_TOUCHKEY=y
# CONFIG_INPUT_BOOSTER is not set

#
# LCD PANEL INFO
#
CONFIG_PANEL_S6E3HA0_AMS510CW01_WQHD=y

#
# Finger print sensor
#
CONFIG_SENSORS_FINGERPRINT=y
CONFIG_SENSORS_FINGERPRINT_SYSFS=y
CONFIG_SENSORS_VFS61XX=y
CONFIG_SENSORS_VFS61XX_KO=y

# SensorHub
CONFIG_SENSORS_SSP=y
CONFIG_SENSORS_SYSFS=y
CONFIG_SENSORS_SSP_ATMEL=y
CONFIG_SENSORS_SSP_SENSORHUB=y
CONFIG_SENSORS_SSP_FACTORY=y
CONFIG_SENSORS_SSP_MPU6500=y
CONFIG_SENSORS_SSP_LPS25H=y
CONFIG_SENSORS_SSP_YAS532=y
CONFIG_SENSORS_SSP_TMG399X=y
CONFIG_SENSORS_SSP_MOBEAM=y
CONFIG_SENSORS_SSP_ATUC128L5HAR=y
CONFIG_IIO=y
CONFIG_IIO_BUFFER=y
CONFIG_IIO_KFIFO_BUF=y
CONFIG_IIO_TRIGGER=y
CONFIG_SENSORS_SSP_ACC_CHECK=y

# Hrm Sensor
CONFIG_SENSORS_MAX86900=y

#B10
CONFIG_USER_RESET_DEBUG=y

#
# CAMERA
#
CONFIG_S5K2P2XX=y
CONFIG_COMPANION=y
CONFIG_LEDS_MAX77828=y
CONFIG_LEDS_MAX77804K=y
CONFIG_DEBUG_FLASH is not set

CONFIG_LEDS_MAX77828_RGB=y
#CONFIG IR LED
CONFIG_SEC_FPGA_ICE40XX=y

# DMB
# CONFIG_TDMB is not set
# CONFIG_TDMB_VENDOR_FCI is not set
# CONFIG_TDMB_FC8080 is not set
# CONFIG_TDMB_SPI is not set
# CONFIG_TDMB_QUALCOMM is not set

#HDMI
CONFIG_SEC_MHL_SII8240=y
CONFIG_MHL_VERSION=0x21

#SSR
# CONFIG_SEC_SSR_DEBUG_LEVEL_CHK is not set

CONFIG_LEDS_AN30259A=y

#QCOM BLUETOOTH
CONFIG_MSM_BT_POWER=y
# CONFIG_BT_BCM4358 is not set

# Samsung ODE
CONFIG_FORCE_DISABLE_FIPS=y

# CONFIG_TIMA_RKP is not set
# CONFIG_TIMA_RKP_KDATA_PROT is not set
# CONFIG_TIMA_RKP_RO_CRED is not set
# CONFIG_KNOX_KAP is not set

# QCOM QCA6174 Wifi
CONFIG_CNSS=y
CONFIG_WCNSS_MEM_PRE_ALLOC=y
CONFIG_CLD_LL_CORE=y
CONFIG_CNSS_MAC_BUG=y
CONFIG_QCA_CLD_WLAN=y
CONFIG_QCACLD_WLAN_LFR3=y
CONFIG_QCOM_VOWIFI_11R=y
CONFIG_QCOM_LTE_COEX=y
CONFIG_QCOM_TDLS=y
CONFIG_PRIMA_WLAN_OKC=y
CONFIG_PRIMA_WLAN_11AC_HIGH_TP=y
CONFIG_WLAN_FEATURE_11W=y
CONFIG_WLAN_FEATURE_LPSS=y
CONFIG_WLAN_FEATURE_NAN=y
```
